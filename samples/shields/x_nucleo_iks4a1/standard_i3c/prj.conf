## CMakeLists.txt
```
# SPDX-FileCopyrightText: Copyright The Zephyr Project Contributors
# SPDX-License-Identifier: Apache-2.0

cmake_minimum_required(VERSION 3.28.0)

set(SHIELD "x_nucleo_iks4a1_i3c")
find_package(Zephyr REQUIRED HINTS $ENV{ZEPHYR_BASE})
project(x_nucleo_iks4a1_i3c)

target_sources(app PRIVATE
  src/main.c
)
```

## prj.conf
```kconfig
# SPDX-FileCopyrightText: Copyright The Zephyr Project Contributors
# SPDX-License-Identifier: Apache-2.0

CONFIG_I3C=y
CONFIG_I3C_CONTROLLER_ROLE_ONLY=y
CONFIG_SENSOR=y
CONFIG_LOG=y
```

## dma.conf
```kconfig
# SPDX-FileCopyrightText: Copyright The Zephyr Project Contributors
# SPDX-License-Identifier: Apache-2.0

CONFIG_I3C_STM32_DMA=y
```

## boards/nucleo_h7s3l8.conf
```kconfig
# SPDX-FileCopyrightText: Copyright The Zephyr Project Contributors
# SPDX-License-Identifier: Apache-2.0

# Enable the Cortex-M7 caches, including when running from external flash.
CONFIG_CACHE_MANAGEMENT=y
```

## boards/nucleo_h7s3l8_stm32h7s3xx_ext_flash_app.conf
```kconfig
# D4 maps to PF3 and A2 maps to PC3 on NUCLEO-H7S3L8, so the LSM6DSV16X and
# LIS2MDL shield interrupt lines collide on STM32 EXTI line 3.
CONFIG_LIS2MDL_TRIGGER_NONE=y
CONFIG_LSM6DSV16X_TRIGGER_NONE=y
```

## boards/nucleo_h7s3l8.overlay
```dts
/*
 * SPDX-FileCopyrightText: Copyright The Zephyr Project Contributors
 * SPDX-License-Identifier: Apache-2.0
 */

&arduino_i2c {
	status = "disabled";
};

&arduino_i3c {
	status = "okay";
};
```

## boards/nucleo_h7s3l8_dma.overlay
```dts
/*
 * SPDX-FileCopyrightText: Copyright The Zephyr Project Contributors
 * SPDX-License-Identifier: Apache-2.0
 */

&gpdma1 {
	status = "okay";
};
```

## boards/nucleo_h7s3l8_stm32h7s3xx_ext_flash_app.overlay
```dts
/*
 * SPDX-FileCopyrightText: Copyright The Zephyr Project Contributors
 * SPDX-License-Identifier: Apache-2.0
 */

#include "nucleo_h7s3l8.overlay"
```

## src/main.c
```c
/*
 * SPDX-FileCopyrightText: Copyright The Zephyr Project Contributors
 * SPDX-License-Identifier: Apache-2.0
 */

#include <zephyr/device.h>
#include <zephyr/drivers/sensor.h>
#include <zephyr/kernel.h>
#include <inttypes.h>

static const struct {
	const struct device *dev;
	enum sensor_channel channel;
	int frequency;
	const char *unit;
	bool vector;
} sensors[] = {
	{ DEVICE_DT_GET(DT_ALIAS(accel1)), SENSOR_CHAN_ACCEL_XYZ, 60, "mm/s^2", true },
	{ DEVICE_DT_GET(DT_ALIAS(press0)), SENSOR_CHAN_PRESS, 10, "Pa", false },
	{ DEVICE_DT_GET(DT_ALIAS(accel0)), SENSOR_CHAN_ACCEL_XYZ, 104, "mm/s^2", true },
	{ DEVICE_DT_GET(DT_ALIAS(magn0)), SENSOR_CHAN_MAGN_XYZ, 10, "mgauss", true },
};

int main(void)
{
	int ret;

	for (size_t i = 0; i < ARRAY_SIZE(sensors); i++) {
		struct sensor_value odr = { .val1 = sensors[i].frequency };
		enum sensor_channel channel = sensors[i].channel == SENSOR_CHAN_PRESS
					      ? SENSOR_CHAN_ALL : sensors[i].channel;

		if (!device_is_ready(sensors[i].dev)) {
			printk("%s is not ready\n", sensors[i].dev->name);
			return 0;
		}

		ret = sensor_attr_set(sensors[i].dev, channel,
				      SENSOR_ATTR_SAMPLING_FREQUENCY, &odr);
		if (ret < 0) {
			printk("%s configuration failed: %d\n", sensors[i].dev->name, ret);
			return 0;
		}
	}

	while (true) {
		for (size_t i = 0; i < ARRAY_SIZE(sensors); i++) {
			struct sensor_value value[3];

			ret = sensor_sample_fetch(sensors[i].dev);
			if (ret == 0) {
				ret = sensor_channel_get(sensors[i].dev, sensors[i].channel, value);
			}
			if (ret < 0) {
				printk("%s sampling failed: %d\n", sensors[i].dev->name, ret);
				return 0;
			}

			printk("%s: %" PRId64, sensors[i].dev->name,
			       sensor_value_to_milli(&value[0]));
			if (sensors[i].vector) {
				printk(", %" PRId64 ", %" PRId64, sensor_value_to_milli(&value[1]),
				       sensor_value_to_milli(&value[2]));
			}
			printk(" %s\n", sensors[i].unit);
		}
		k_sleep(K_SECONDS(1));
	}

	return 0;
}
```
