## drivers/i3c/Kconfig.stm32
```kconfig
# Copyright (c) 2024 EXALT Technologies.
#
# SPDX-License-Identifier: Apache-2.0

module = I3C_STM32
module-str = i3c_stm32

source "subsys/logging/Kconfig.template.log_config"
config I3C_STM32
	bool "STM32 I3C driver support"
	depends on DT_HAS_ST_STM32_I3C_ENABLED
	select I3C_IBI_WORKQUEUE if I3C_USE_IBI && I3C_CONTROLLER
	select PINCTRL
	select RESET
	default y
	help
	  Enable support for I3C on STM32 microcontrollers.

if I3C_STM32

config I3C_STM32_COMBINED_INTERRUPT
	bool
	default y if SOC_SERIES_STM32MP2X

config I3C_STM32_DMA
	bool "STM32 I3C DMA driver support"
	depends on I3C_CONTROLLER
	select DMA
	select CACHE_MANAGEMENT if DCACHE
	help
	  Enables support for I3C DMA mode on STM32 microcontrollers.

config I3C_STM32_DMA_FIFO_HEAP_SIZE
	int "DMA transfer buffer heap"
	depends on I3C_STM32_DMA
	default 2048
	help
	  Size of the heap used for DMA control words, status words and byte-stream
	  buffers. Allow eight bytes per message, the total read and write lengths,
	  cache-line padding and allocator overhead. Transfers that exceed the
	  available storage fail with ENOMEM.

endif # I3C_STM32
```

## dts/bindings/sensor/st,lsm6dsv32x-i2c.yaml
```yaml
# Copyright (c) 2025 Meta Platforms
# SPDX-License-Identifier: Apache-2.0

description: |
    STMicroelectronics LSM6DSV32X 6-axis IMU (Inertial Measurement Unit) sensor
    accessed through I2C bus

compatible: "st,lsm6dsv32x"

include: ["i2c-device.yaml", "st,lsm6dsv32x-common.yaml"]

properties:
  qvar-enable:
    type: boolean
    description: |
      Enable the QVAR charge-variation sensing path for this I2C device
      instance.

  qvar-input-impedance-mohm:
    type: int
    default: 2400
    enum:
      - 2400
      - 730
      - 300
      - 255
    description: |
      Equivalent input impedance of the AH/QVAR buffers, in megaohms.
      Lower values reduce sensitivity and help avoid saturation with direct
      touch electrodes.
```
