## boards/nxp/frdm_imx95/Kconfig
```kconfig
# SPDX-FileCopyrightText: Copyright The Zephyr Project Contributors
# SPDX-License-Identifier: Apache-2.0

config BOARD_FRDM_IMX95_SPSDK
	bool "Enable the SPSDK flash runner"
	depends on BOARD_FRDM_IMX95
	help
	  Register the SPSDK runner for west flash. Supply the FRDM BSP
	  bootloader and the assembled AHAB boot container when flashing.
```

## boards/nxp/frdm_imx95/Kconfig.frdm_imx95
```kconfig
# SPDX-FileCopyrightText: Copyright The Zephyr Project Contributors
# SPDX-License-Identifier: Apache-2.0

config BOARD_FRDM_IMX95
	select SOC_MIMX9596_M7 if BOARD_FRDM_IMX95_MIMX9596_M7 || BOARD_FRDM_IMX95_MIMX9596_M7_DDR
	select SOC_PART_NUMBER_MIMX9596AVZXN
```

## boards/nxp/frdm_imx95/board.yml
```yaml
# SPDX-FileCopyrightText: Copyright The Zephyr Project Contributors
# SPDX-License-Identifier: Apache-2.0

board:
  name: frdm_imx95
  full_name: FRDM-IMX95
  vendor: nxp
  socs:
  - name: mimx9596
    variants:
    - name: ddr
      cpucluster: m7
```
